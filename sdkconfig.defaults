## sdkconfig.defaults
```kconfig
#
# ST7789 Configuration
#
CONFIG_WIDTH=135
CONFIG_HEIGHT=240
CONFIG_OFFSETX=52
CONFIG_OFFSETY=40
CONFIG_MOSI_GPIO=19
CONFIG_SCLK_GPIO=18
CONFIG_CS_GPIO=5
CONFIG_DC_GPIO=16
CONFIG_RESET_GPIO=23
CONFIG_BL_GPIO=4
# CONFIG_INVERSION is not set
# end of ST7789 Configuration
CONFIG_PARTITION_TABLE_CUSTOM=y
CONFIG_PARTITION_TABLE_CUSTOM_FILENAME="partitions_example.csv"
CONFIG_PARTITION_TABLE_CUSTOM_APP_BIN_OFFSET=0x10000
CONFIG_PARTITION_TABLE_FILENAME="partitions_example.csv"
CONFIG_APP_OFFSET=0x10000
CONFIG_ESPTOOLPY_FLASHSIZE_4MB=y
CONFIG_ESP32_DEFAULT_CPU_FREQ_240=y
CONFIG_ESP32_DEFAULT_CPU_FREQ_MHZ=240
```
